## package/fcsdump/Config.in
```kconfig
config BR2_PACKAGE_FCSDUMP
	bool "fcsdump"
    select BR2_PACKAGE_LIBFTDI
	help
	  Small program to dump high-rate DSP telemetry to a file.

	  https://github.com/sfwa/fcs/blob/master/cpu/fcsdump.c
```

## package/gcs/Config.in
```kconfig
config BR2_PACKAGE_GCS
	bool "gcs"
	select BR2_PACKAGE_JPEG
	select BR2_PACKAGE_PYTHON_COBS
	select BR2_PACKAGE_PYTHON_ENUM34
	help
	  SFWA GCS software.

	  https://github.com/sfwa/gcs
```

## package/gphoto2/Config.in
```kconfig
config BR2_PACKAGE_GPHOTO2
	bool "gphoto2"
	select BR2_PACKAGE_LIBEXIF
	select BR2_PACKAGE_LIBGPHOTO2
	select BR2_PACKAGE_POPT
	help
	  Command-line client for libgphoto2.

	  http://www.gphoto.org/proj/gphoto2/
```

## package/imagecapture/Config.in
```kconfig
config BR2_PACKAGE_IMAGECAPTURE
	bool "imagecapture"
	select BR2_PACKAGE_LIBUSB
	help
	  Periodically captures images from a Point Grey
	  Chameleon camera and saves associated telemetry.

	  https://github.com/sfwa/imagecapture
```

## package/imagescanner/Config.in
```kconfig
config BR2_PACKAGE_IMAGESCANNER
	bool "imagescanner"
	select BR2_PACKAGE_JPEG
	select BR2_PACKAGE_PYTHON_COBS
	select BR2_PACKAGE_PYTHON_ENUM34
	help
	  Scans images captured by imagecapture.

	  https://github.com/sfwa/imagescanner
```

## package/libdc1394/Config.in
```kconfig
config BR2_PACKAGE_LIBDC1394
	bool "libdc1394"
	select BR2_PACKAGE_LIBUSB
	help
	  Library for controlling IIDC 1394-based cameras.

	  http://damien.douxchamps.net/ieee1394/libdc1394/
```

## package/libgphoto2/Config.in
```kconfig
config BR2_PACKAGE_LIBGPHOTO2
	bool "libgphoto2"
	select BR2_PACKAGE_LIBEXIF
	select BR2_PACKAGE_LIBUSB
	select BR2_PACKAGE_LIBTOOL
	help
	  Library for controlling digital cameras remotely.

	  http://www.gphoto.org/proj/libgphoto2/
```

## package/python-certifi/Config.in
```kconfig
config BR2_PACKAGE_PYTHON_CERTIFI
	bool "python-certifi"
	depends on BR2_PACKAGE_PYTHON
	help
	  Python package for providing Mozilla's CA Bundle.

	  https://pypi.python.org/pypi/certifi
```

## package/python-cobs/Config.in
```kconfig
config BR2_PACKAGE_PYTHON_COBS
	bool "python-cobs"
	depends on BR2_PACKAGE_PYTHON
	help
	  Python functions for encoding and decoding COBS.

	  https://pypi.python.org/pypi/cobs
```

## package/python-enum34/Config.in
```kconfig
config BR2_PACKAGE_PYTHON_ENUM34
	bool "python-enum34"
	depends on BR2_PACKAGE_PYTHON
	help
	  Python 3.4 Enum backported to 3.3, 3.2, 3.1, 2.7, 2.6, 2.5, and 2.4.

	  https://pypi.python.org/pypi/enum34
```

## package/python-pyinotify/Config.in
```kconfig
config BR2_PACKAGE_PYTHON_PYINOTIFY
	bool "python-pyinotify"
	depends on BR2_PACKAGE_PYTHON || BR2_PACKAGE_PYTHON3
	help
	  Monitoring filesystems events with inotify on Linux.

	  http://github.com/seb-m/pyinotify/wiki
```

## package/python-ssl-match-hostname/Config.in
```kconfig
config BR2_PACKAGE_PYTHON_SSL_MATCH_HOSTNAME
	bool "python-ssl-match-hostname"
	depends on BR2_PACKAGE_PYTHON
	help
	  The ssl.match_hostname() function from Python 3.4

	  https://pypi.python.org/pypi/backports.ssl_match_hostname
```

## package/python-tornado/Config.in
```kconfig
config BR2_PACKAGE_PYTHON_TORNADO
	bool "python-tornado"
	depends on BR2_PACKAGE_PYTHON
	select BR2_PACKAGE_PYTHON_CERTIFI
	select BR2_PACKAGE_PYTHON_SSL_MATCH_HOSTNAME
	help
	  Tornado is a Python web framework and asynchronous networking
	  library, originally developed at FriendFeed.

	  http://www.tornadoweb.org
```
